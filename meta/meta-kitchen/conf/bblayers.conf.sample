## meta/meta-kitchen/conf/bblayers.conf.sample
```bitbake
# POKY_BBLAYERS_CONF_VERSION is increased each time build/conf/bblayers.conf
# changes incompatibly
POKY_BBLAYERS_CONF_VERSION = "2"

BBPATH = "${TOPDIR}"
BBFILES ?= ""

BBLAYERS ?= " \
  ${HOME}/kitchen-atom/sources/poky/meta \
  ${HOME}/kitchen-atom/sources/poky/meta-poky \
  ${HOME}/kitchen-atom/sources/meta-openembedded/meta-oe \
  ${HOME}/kitchen-atom/sources/meta-openembedded/meta-networking \
  ${HOME}/kitchen-atom/sources/meta-openembedded/meta-multimedia \
  ${HOME}/kitchen-atom/sources/meta-intel \
  ${HOME}/kitchen-atom/sources/meta-mesa \
  ${HOME}/kitchen-atom/sources/meta-kodi \
  ${HOME}/kitchen-atom/meta/meta-kitchen \
  ${HOME}/kitchen-atom/meta/meta-python \ 
  "
```

## meta/meta-kitchen/conf/layer.conf
```bitbake
# We have a conf and classes directory, add to BBPATH
BBPATH .= ":${LAYERDIR}"

# We have recipes-* directories, add to BBFILES
BBFILES += "${LAYERDIR}/recipes-*/*/*.bb \
            ${LAYERDIR}/recipes-*/*/*.bbappend"

BBFILE_COLLECTIONS += "meta-kitchen"
BBFILE_PATTERN_meta-kitchen = "^${LAYERDIR}/"
BBFILE_PRIORITY_meta-kitchen = "16"

LAYERDEPENDS_meta-kitchen = "core"
LAYERSERIES_COMPAT_meta-kitchen = "warrior zeus"
```

## meta/meta-kitchen/conf/local.conf.sample
```bitbake
# Local configuration for meta-atom images
# Supporting 32-bit Atom eee100hg netbooks
# Yocto Project 3.0 Poky distribution [zeus] branch
# Enable some codecs
LICENSE_FLAGS_WHITELIST = "commercial"

DISTRO_FEATURES_append = " ext2 pam systemd alsa pulseaudio opengl wifi wayland"
DISTRO_FEATURES_remove = " x11"

IMAGE_FEATURES_append = " splash"

# Systemd
DISTRO_FEATURES_BACKFILL_CONSIDERED += "sysvinit"
VIRTUAL-RUNTIME_init_manager = "systemd"
VIRTUAL-RUNTIME_initscripts = ""

PREFERRED_PROVIDER_jpeg = "libjpeg-turbo"

# Machine
MACHINE = "intel-core2-32"

# Kernel
PREFERRED_PROVIDER_virtual/kernel = "linux-yocto"
PREFERRED_VERSION_linux-intel = "5.2.%"

# Installed software
SYSTEM_PKG = " \
  eee-acpi-scripts \
  psplash \
  weston \
  weston-init \
  b43-firmware \
"

KODI_PKG = " \
  kodi \
  python-pycryptodomex \
  kodi-addon-inputstream-adaptive \
  nspr \
  nss \
"

IMAGE_INSTALL_append = " ${SYSTEM_PKG} ${KODI_PKG}"

# Kodi setup
VAAPISUPPORT = "0"
VDPAUSUPPORT = "0"
KODIGRAPHICALBACKEND = "gbm"
KODISYSTEMDAUTOSTART="disable"

# Distro setup
DISTRO = "poky"
PACKAGE_CLASSES = "package_ipk"
SDKMACHINE = "x86_64"

# for no root password
EXTRA_IMAGE_FEATURES_append = " debug-tweaks"
#EXTRA_IMAGE_FEATURES_append = " dbg-pkgs"

# GPU Drivers setup
ADDITIONAL_MESA_GPUS ?= " \
  gallium-llvm \
  i915 \
"

PACKAGECONFIG_append_pn-mesa = "${ADDITIONAL_MESA_GPUS}"

# Random tweaks
USER_CLASSES = "image-mklibs image-prelink"

PATCHRESOLVE = "noop"
RM_OLD_IMAGE = "1"
INHERIT += "ccache rm_work"
CONF_VERSION = "1"
```
